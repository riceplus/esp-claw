## components/claw_modules/claw_core/Kconfig
```kconfig
menu "ESP-Claw Core"

choice CLAW_CORE_STAGE_VERBOSITY
    prompt "Agent stage notification verbosity"
    default CLAW_CORE_STAGE_VERBOSITY_SIMPLE
    help
        Controls how much detail is forwarded to IM channels during agent execution.

config CLAW_CORE_STAGE_VERBOSITY_SIMPLE
    bool "Simple"
    help
        Send only essential updates: tool names being invoked.

config CLAW_CORE_STAGE_VERBOSITY_VERBOSE
    bool "Verbose"
    help
        Include tool arguments preview and iteration round in addition to tool
        names. Useful for debugging and power users.

endchoice

config CLAW_LLM_HTTP_RETRY_COUNT
    int "LLM HTTP transient failure retry count"
    default 3
    range 0 10
    help
        Number of retries for transient network failures (ESP_ERR_HTTP_EAGAIN,
        i.e. connection read timeout) during LLM HTTP requests. A single
        transient timeout currently fails the whole agent turn; retrying masks
        momentary Wi-Fi/TLS/server slowness. Set to 0 to disable retries.

config CLAW_LLM_HTTP_RETRY_BACKOFF_MS
    int "LLM HTTP retry backoff delay (ms)"
    default 1000
    range 100 10000
    help
        Base backoff delay in milliseconds between LLM HTTP retries. The delay
        grows linearly: attempt N waits backoff_ms * N.

endmenu
```
